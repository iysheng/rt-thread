## bsp/gd32450z-eval/Kconfig
```kconfig
mainmenu "RT-Thread Configuration"

config BSP_DIR
    string
    option env="BSP_ROOT"
    default "."

config RTT_DIR
    string
    option env="RTT_ROOT"
    default "../.."
    
# you can change the RTT_ROOT default: "rt-thread"
# example : default "F:/git_repositories/rt-thread"

config PKGS_DIR
    string
    option env="PKGS_ROOT"
    default "packages"

source "$RTT_DIR/Kconfig"
source "$PKGS_DIR/Kconfig"

config SOC_GD32450Z
    bool 
    select RT_USING_COMPONENTS_INIT
    select RT_USING_USER_MAIN
    default y

config BSP_USING_SDRAM
    bool "Using sdram"
    default y 

config BSP_USING_UART0
    bool "using uart0"
    select RT_USING_SERIAL
    default n
config BSP_USING_UART1
    bool "using uart1"
    select RT_USING_SERIAL
    default n
config BSP_USING_UART2
    bool "using uart2"
    select RT_USING_SERIAL
    default y
config BSP_USING_UART3
    bool "using uart3"
    select RT_USING_SERIAL
    default n
config BSP_USING_UART4
    bool "using uart4"
    select RT_USING_SERIAL
    default n
config BSP_USING_UART5
    bool "using uart5"
    select RT_USING_SERIAL
    default n
config BSP_USING_LPUART1
    bool "using lpuart1"
    select RT_USING_SERIAL
    default n

config BSP_USING_GPIO
    bool "using gpio"
    select RT_USING_PIN
    default n

menuconfig BSP_USING_CAN
    bool "using can"
    default n
    select RT_USING_CAN
    if BSP_USING_CAN
        config RT_USING_CAN0
        bool "using can0 device"
        default n
    endif
menuconfig BSP_USING_ENCODER
    bool "using encoder"
    default n
    if BSP_USING_ENCODER
    endif
```

## bsp/gd32450z-eval/applications/Kconfig
```kconfig
menu "Application Configuration"
menuconfig BSP_USING_CAN_COMM
    bool "using can commiuncate support"
    default n
    select BSP_USING_CAN
    if BSP_USING_CAN_COMM
    endif
endmenu
```

## bsp/gd32vf103v-eval/board/Kconfig
```kconfig
menu "Hardware Drivers Config"

config SOC_GD32VF103V
    bool
    select SOC_SERIES_GD32VF103V
    default y

menu "Onboard Peripheral Drivers"

    config BSP_USING_USART
        bool "Enable USART (usart0)"
        select BSP_USING_UART
        select BSP_USING_UART0
        default y
endmenu

menu "On-chip Peripheral Drivers"

    config BSP_USING_GPIO
        bool "Enable GPIO"
        select RT_USING_PIN
        default y

    config BSP_USING_SEG
        bool "Enable SEG"
        default n

    menuconfig BSP_USING_INFRA
        bool "Enable INFRA"
        default n
        if BSP_USING_INFRA
            config INFRA_SEND_DEVICE
            bool "infra send device"
            default y
        endif

    menuconfig BSP_USING_UART
        bool "Enable USART"
        default y
        select RT_USING_SERIAL
        if BSP_USING_UART
            config BSP_USING_UART0
                bool "Enable USART0"
                default y
        endif    

endmenu

menu "Board extended module Drivers"

endmenu

endmenu
```
