## bsp/gd32/gd32205/drivers/Kconfig
```kconfig
menu "Board Drivers"

config BSP_USING_TCD1209
    bool "Using tcd1209 device"
    default y

menuconfig BSP_USING_CAN
    bool "Using can device"
    default y
    if BSP_USING_CAN
    config BSP_USING_CAN0
        bool "Using can0 device"
        default y
    endif

endmenu
```

## bsp/renesas/libraries/HAL_Drivers/Kconfig
```kconfig
config BSP_USING_GPIO
    bool "Enable GPIO"
    select RT_USING_PIN
    default y

config BSP_USING_ONCHIP_FLASH
    bool "Enable Onchip FLASH"
    default n

config BSP_USING_WDT
    bool "Enable Watchdog Timer"
    select RT_USING_WDT
    default n

menuconfig BSP_USING_CAN
    bool "Enable CAN"
    select RT_USING_CAN
    default n
    if BSP_USING_CAN
    config BSP_USING_CAN0
    bool "Enable CAN0"
    default n
    config BSP_USING_CAN1
    bool "Enable CAN1"
    default n
    endif

menuconfig BSP_USING_ONCHIP_RTC
    bool "Enable RTC"
    select RT_USING_RTC
    default n
    if BSP_USING_ONCHIP_RTC
    endif
```

## bsp/wch/riscv/Libraries/Kconfig
```kconfig
config SOC_RISCV_FAMILY_CH32
    bool
    select ARCH_RISCV32

config SOC_RISCV_SERIES_CH32V103
    bool
    select SOC_RISCV_FAMILY_CH32
```

## libcpu/risc-v/common/Kconfig
```kconfig
menu "RT-Thread RISC-V CPU"

    config RT_USING_SW4SWITCH
        bool "Using Similar software interrupt to kick context switch"
        default n
        help
            Using Software interrupt to kick context switch.

endmenu
```
